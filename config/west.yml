## config/west.yml
```yaml
manifest:
  defaults:
    revision: v0.3
  remotes:
    - name: zmkfirmware
      url-base: https://github.com/zmkfirmware
    # Additional modules containing boards/shields/custom code can be listed here as well
    # See https://docs.zephyrproject.org/3.2.0/develop/west/manifest.html#projects
    # bravekarma
    - name: caksoylar
      url-base: https://github.com/caksoylar
      # kyek / duckyb
    - name: duckyb
      url-base: https://github.com/duckyb
      # nice-view-gem
    - name: m165437
      url-base: https://github.com/M165437
  projects:
    - name: zmk
      remote: zmkfirmware
      import: app/west.yml
    - name: urchin-zmk-module
      remote: duckyb
      revision: main
    - name: nice-view-gem
      remote: m165437
      revision: main
  self:
    path: config
```
